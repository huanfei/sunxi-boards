## sys_config/a20/sun7i.its
```
/*
 * U-Boot uImage source file with fex script
 */

/dts-v1/;

/ {
	description = "Various kernels, ramdisks and FDT blobs";
	#address-cells = <1>;

	images {
		uboot@1 {
			description = "uboot";
			data = /incbin/("./u-boot.bin");
			type = "firmware";
			compression = "none";
			arch = "arm";
			os = "U-Boot";
			load =  <0x4a000000>;
			entry = <0x00000000>;
			hash@1 {
				algo = "sha1";
			};
		};

		fex@1 {
			description = "Sunxi Fex Config";
			data = /incbin/("./sys_config.bin");
			compression = "none";
			type = "script";
			load = <0x43000000>;
			entry = <0x00000000>;
			hash@1 {
				algo = "sha1";
			};
		};

	};
	configurations {
		default = "config@1";

		config@1 {
			description = "mxBenjen";
			uboot = "uboot@1";
			fex = "fex@1";
			loadables = "uboot@1", "fex@1";
		};
	};
};
```
